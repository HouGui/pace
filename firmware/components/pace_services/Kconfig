## firmware/components/pace_services/Kconfig
```kconfig
# SPDX-License-Identifier: MIT
config PACE_NETWORK_DEPENDENCIES
    bool
    default y
    select MBEDTLS_SSL_KEEP_PEER_CERTIFICATE
    select MBEDTLS_SSL_PROTO_TLS1_2
    select MBEDTLS_SSL_PROTO_TLS1_3
    select MBEDTLS_SSL_TLS1_3_KEXM_EPHEMERAL
    help
        Support authenticated TLS 1.2 and 1.3, including routing services that
        require TLS 1.3. Applies to existing saved build configurations too.
```

## firmware/components/pace_ui/Kconfig
```kconfig
# SPDX-License-Identifier: MIT
config PACE_UI_DEPENDENCIES
    bool
    default y
    select LV_USE_BUTTON
    select LV_USE_LABEL
    select LV_USE_LINE
    select LV_USE_BAR
    select LV_USE_SLIDER
    select LV_USE_IMAGE
    select LV_USE_CANVAS
    select LV_USE_FLEX
    select LV_USE_QRCODE
    select LV_USE_LODEPNG
    select LV_FONT_MONTSERRAT_16
    select LV_FONT_MONTSERRAT_24
    help
        Required by PACE's compiled display code. Select dependencies here so
        upgrades also enable them in an existing sdkconfig; defaults alone
        do not override previously saved disabled options.
```

## firmware/main/Kconfig.projbuild
```kconfig
menu "PACE"
config PACE_OTA_MANIFEST_URL
    string "Default HTTPS update manifest URL (optional)"
    default ""
    help
        Optional default; a URL saved through local setup takes precedence.
        Leave empty to use signed-file uploads without hosting. HTTPS images
        must share the manifest origin. All OTA paths require signed-app verification.
config PACE_GUI_ROTATE_180
    bool "Rotate display and touch by 180 degrees for enclosure A"
    default y
    help
        Fits the reference enclosure orientation. Disable for the panel's native
        orientation on the bench. Uses in-place rotation of partial draw buffers.
endmenu
```

## firmware/sdkconfig.defaults
```kconfig
# Waveshare ESP32-S3-Touch-LCD-7: conservative 8 MB flash, 8 MB octal PSRAM.
# Single PSRAM framebuffer plus internal DMA bounce buffers; validate on the board.
CONFIG_ESPTOOLPY_FLASHSIZE_8MB=y
CONFIG_ESPTOOLPY_FLASHMODE_DIO=y
CONFIG_ESPTOOLPY_FLASHFREQ_80M=y
CONFIG_SPIRAM=y
CONFIG_SPIRAM_MODE_OCT=y
CONFIG_SPIRAM_SPEED_80M=y
CONFIG_SPIRAM_USE_MALLOC=y
CONFIG_PARTITION_TABLE_CUSTOM=y
CONFIG_PARTITION_TABLE_CUSTOM_FILENAME="partitions.csv"
CONFIG_BOOTLOADER_APP_ROLLBACK_ENABLE=y
CONFIG_ESP_CONSOLE_UART_DEFAULT=y
CONFIG_LOG_DEFAULT_LEVEL_INFO=y
CONFIG_ESP_MAIN_TASK_STACK_SIZE=16384
CONFIG_FREERTOS_HZ=1000
CONFIG_MBEDTLS_CERTIFICATE_BUNDLE=y
CONFIG_LCD_RGB_RESTART_IN_VSYNC=y
CONFIG_SPIRAM_FETCH_INSTRUCTIONS=y
CONFIG_SPIRAM_RODATA=y
CONFIG_LV_COLOR_DEPTH_16=y
CONFIG_LV_FONT_MONTSERRAT_16=y
CONFIG_LV_FONT_MONTSERRAT_24=y
CONFIG_LV_USE_QRCODE=y
CONFIG_LV_USE_CLIB_MALLOC=y
CONFIG_LV_USE_CLIB_STRING=y
CONFIG_LV_USE_CLIB_SPRINTF=y
# CONFIG_LV_BUILD_EXAMPLES is not set
# CONFIG_LV_BUILD_DEMOS is not set
CONFIG_HTTPD_MAX_REQ_HDR_LEN=1024
CONFIG_ESP_TASK_WDT_TIMEOUT_S=60
CONFIG_ESP_TASK_WDT_PANIC=y
# Development profile only: no encryption, signing keys or eFuse operations.
# CONFIG_COMPILER_CXX_EXCEPTIONS is not set
# CONFIG_COMPILER_CXX_RTTI is not set

CONFIG_PACE_GUI_ROTATE_180=y

# Only GUI widgets used by PACE; PNG decoding is bundled with pinned LVGL.
CONFIG_LV_USE_LODEPNG=y
# CONFIG_LV_USE_ANIMIMG is not set
# CONFIG_LV_USE_ARC is not set
# CONFIG_LV_USE_ARCLABEL is not set
# CONFIG_LV_USE_BUTTONMATRIX is not set
# CONFIG_LV_USE_CALENDAR is not set
# CONFIG_LV_USE_CALENDAR_HEADER_ARROW is not set
# CONFIG_LV_USE_CALENDAR_HEADER_DROPDOWN is not set
# CONFIG_LV_USE_CHART is not set
# CONFIG_LV_USE_CHECKBOX is not set
# CONFIG_LV_USE_DROPDOWN is not set
# CONFIG_LV_USE_IMAGEBUTTON is not set
# CONFIG_LV_USE_KEYBOARD is not set
# CONFIG_LV_USE_LED is not set
# CONFIG_LV_USE_LIST is not set
# CONFIG_LV_USE_MENU is not set
# CONFIG_LV_USE_MSGBOX is not set
# CONFIG_LV_USE_ROLLER is not set
# CONFIG_LV_USE_SCALE is not set
# CONFIG_LV_USE_SPAN is not set
# CONFIG_LV_USE_SPINBOX is not set
# CONFIG_LV_USE_SPINNER is not set
# CONFIG_LV_USE_SWITCH is not set
# CONFIG_LV_USE_TEXTAREA is not set
# CONFIG_LV_USE_TABLE is not set
# CONFIG_LV_USE_TABVIEW is not set
# CONFIG_LV_USE_TILEVIEW is not set
# CONFIG_LV_USE_WIN is not set
```
